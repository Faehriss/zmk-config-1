/*
 * Copyright (c) 2021 Dan Thomas
 *
 * SPDX-License-Identifier: MIT
 */

#include <behaviors.dtsi>
#include <dt-bindings/zmk/keys.h>

/ {
    keymap {
        compatible = "zmk,keymap";

        default {
           bindings = <
// You probably want to change the line below...
                &mt RCTRL SPACE
            >;
        };
    };
};
