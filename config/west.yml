## config/west.yml
```yaml
manifest:
  remotes:
    - name: zmkfirmware
      url-base: https://github.com/godders
  projects:
    - name: zmk
      remote: zmkfirmware
      revision: feature/isopad
      import: app/west.yml
  self:
    path: config
```
